## arch/arm64/configs/m14x_defconfig
```kconfig
CONFIG_AUDIT=y
CONFIG_NO_HZ=y
CONFIG_HIGH_RES_TIMERS=y
CONFIG_BPF_SYSCALL=y
CONFIG_BPF_JIT=y
CONFIG_BPF_JIT_ALWAYS_ON=y
CONFIG_PREEMPT=y
CONFIG_IRQ_TIME_ACCOUNTING=y
CONFIG_TASKSTATS=y
CONFIG_TASK_XACCT=y
CONFIG_TASK_IO_ACCOUNTING=y
CONFIG_PSI=y
CONFIG_RCU_EXPERT=y
CONFIG_RCU_FAST_NO_HZ=y
CONFIG_RCU_BOOST=y
CONFIG_RCU_NOCB_CPU=y
CONFIG_RCU_LAZY=y
CONFIG_RCU_LAZY_DEFAULT_OFF=y
CONFIG_IKCONFIG=y
CONFIG_IKCONFIG_PROC=y
CONFIG_IKHEADERS=y
CONFIG_UCLAMP_TASK=y
CONFIG_UCLAMP_BUCKETS_COUNT=20
CONFIG_CGROUPS=y
CONFIG_MEMCG=y
CONFIG_BLK_CGROUP=y
CONFIG_CGROUP_SCHED=y
CONFIG_UCLAMP_TASK_GROUP=y
CONFIG_CGROUP_FREEZER=y
CONFIG_CPUSETS=y
CONFIG_CGROUP_CPUACCT=y
CONFIG_CGROUP_BPF=y
CONFIG_NAMESPACES=y
# CONFIG_PID_NS is not set
CONFIG_SCHED_EMS=m
CONFIG_SCHED_EMS_TUNE=y
CONFIG_RT_SOFTINT_OPTIMIZATION=y
CONFIG_RELAY=y
# CONFIG_RD_BZIP2 is not set
# CONFIG_RD_LZMA is not set
# CONFIG_RD_XZ is not set
# CONFIG_RD_LZO is not set
CONFIG_BOOT_CONFIG=y
# CONFIG_SYSFS_SYSCALL is not set
# CONFIG_FHANDLE is not set
CONFIG_KALLSYMS_ALL=y
CONFIG_USERFAULTFD=y
# CONFIG_RSEQ is not set
CONFIG_EMBEDDED=y
# CONFIG_COMPAT_BRK is not set
# CONFIG_SLAB_MERGE_DEFAULT is not set
CONFIG_SLAB_FREELIST_RANDOM=y
CONFIG_SLAB_FREELIST_HARDENED=y
CONFIG_SHUFFLE_PAGE_ALLOCATOR=y
CONFIG_PROFILING=y
CONFIG_ARCH_SUNXI=y
CONFIG_ARCH_HISI=y
CONFIG_ARCH_QCOM=y
CONFIG_SCHED_MC=y
CONFIG_NR_CPUS=32
CONFIG_PARAVIRT_TIME_ACCOUNTING=y
CONFIG_ARM64_SW_TTBR0_PAN=y
CONFIG_COMPAT=y
CONFIG_ARMV8_DEPRECATED=y
CONFIG_SWP_EMULATION=y
CONFIG_CP15_BARRIER_EMULATION=y
CONFIG_SETEND_EMULATION=y
CONFIG_ARM64_MPAM=y
CONFIG_RANDOMIZE_BASE=y
# CONFIG_RANDOMIZE_MODULE_REGION_FULL is not set
CONFIG_CMDLINE="stack_depot_disable=on kasan.stacktrace=off kvm-arm.mode=protected cgroup_disable=pressure"
CONFIG_CMDLINE_EXTEND=y
# CONFIG_DMI is not set
CONFIG_HIBERNATION=y
CONFIG_PM_WAKELOCKS=y
CONFIG_PM_WAKELOCKS_LIMIT=0
# CONFIG_PM_WAKELOCKS_GC is not set
CONFIG_PM_DEBUG=y
CONFIG_ENERGY_MODEL=y
CONFIG_CPU_IDLE=y
CONFIG_CPU_IDLE_GOV_MENU=y
CONFIG_CPU_IDLE_GOV_TEO=y
CONFIG_CPU_IDLE_GOV_HALO=y
CONFIG_ARM_CPUIDLE=y
CONFIG_ARM_PSCI_CPUIDLE=y
CONFIG_CPU_FREQ=y
CONFIG_CPU_FREQ_STAT=y
CONFIG_CPU_FREQ_TIMES=y
CONFIG_CPU_FREQ_GOV_POWERSAVE=y
CONFIG_CPU_FREQ_GOV_CONSERVATIVE=y
CONFIG_ARM_SCPI_CPUFREQ=y
CONFIG_ARM_SCMI_CPUFREQ=y
CONFIG_ARM_EXYNOS_ACME=m
CONFIG_ARM_FREQ_QOS_TRACER=m
CONFIG_ARM_EXYNOS_DSU_FREQ=m
CONFIG_VIRTUALIZATION=y
CONFIG_KVM=y
CONFIG_KVM_S2MPU=y
CONFIG_CRYPTO_SHA1_ARM64_CE=y
CONFIG_CRYPTO_SHA2_ARM64_CE=y
CONFIG_CRYPTO_SHA512_ARM64_CE=y
CONFIG_CRYPTO_GHASH_ARM64_CE=y
CONFIG_CRYPTO_AES_ARM64_CE_BLK=y
CONFIG_KPROBES=y
CONFIG_JUMP_LABEL=y
CONFIG_SHADOW_CALL_STACK=y
CONFIG_LTO_CLANG_THIN=y
CONFIG_CFI_CLANG=y
CONFIG_MODULES=y
CONFIG_MODULE_UNLOAD=y
CONFIG_MODVERSIONS=y
CONFIG_MODULE_SCMVERSION=y
CONFIG_MODULE_SIG=y
CONFIG_MODULE_SIG_PROTECT=y
CONFIG_TRIM_UNUSED_KSYMS=y
CONFIG_UNUSED_KSYMS_WHITELIST="gki/abi_symbollist.raw"
# CONFIG_BLOCK_LEGACY_AUTOLOAD is not set
CONFIG_BLK_CGROUP_IOCOST=y
CONFIG_BLK_CGROUP_IOPRIO=y
CONFIG_BLK_INLINE_ENCRYPTION=y
CONFIG_BLK_INLINE_ENCRYPTION_FALLBACK=y
CONFIG_BLK_SEC_STATS=m
CONFIG_BLK_SEC_WB=m
CONFIG_IOSCHED_BFQ=y
CONFIG_BFQ_GROUP_IOSCHED=y
CONFIG_MQ_IOSCHED_SSG=m
CONFIG_MQ_IOSCHED_SSG_CGROUP=m
CONFIG_MQ_IOSCHED_SSG_WB=m
CONFIG_GKI_HACKS_TO_FIX=y
# CONFIG_CORE_DUMP_DEFAULT_ELF_HEADERS is not set
CONFIG_BINFMT_MISC=y
CONFIG_MEMORY_HOTPLUG=y
CONFIG_MEMORY_HOTREMOVE=y
CONFIG_DEFAULT_MMAP_MIN_ADDR=32768
CONFIG_TRANSPARENT_HUGEPAGE=y
CONFIG_TRANSPARENT_HUGEPAGE_MADVISE=y
CONFIG_CLEANCACHE=y
CONFIG_CMA_DEBUGFS=y
CONFIG_CMA_AREAS=32
CONFIG_ZSMALLOC=m
# CONFIG_ZONE_DMA is not set
CONFIG_KSWAPD_CPU=0
CONFIG_MMAP_READAROUND_LIMIT=8
CONFIG_FAULT_AROUND_4KB=y
CONFIG_ANON_VMA_NAME=y
CONFIG_LRU_GEN=y
CONFIG_LRU_GEN_ENABLED=y
CONFIG_DAMON=y
CONFIG_DAMON_PADDR=y
CONFIG_DAMON_RECLAIM=y
CONFIG_HPA=y
CONFIG_NET=y
CONFIG_PACKET=y
CONFIG_UNIX=y
CONFIG_XFRM_USER=y
CONFIG_XFRM_INTERFACE=y
CONFIG_XFRM_MIGRATE=y
CONFIG_XFRM_STATISTICS=y
CONFIG_NET_KEY=y
CONFIG_XDP_SOCKETS=y
CONFIG_INET=y
CONFIG_IP_MULTICAST=y
CONFIG_IP_ADVANCED_ROUTER=y
CONFIG_IP_MULTIPLE_TABLES=y
CONFIG_NET_IPIP=y
CONFIG_NET_IPGRE_DEMUX=y
CONFIG_NET_IPGRE=y
CONFIG_SYN_COOKIES=y
CONFIG_NET_IPVTI=y
CONFIG_INET_ESP=y
CONFIG_INET_UDP_DIAG=y
CONFIG_INET_DIAG_DESTROY=y
CONFIG_TCP_CONG_ADVANCED=y
CONFIG_IPV6_ROUTER_PREF=y
CONFIG_IPV6_ROUTE_INFO=y
CONFIG_IPV6_OPTIMISTIC_DAD=y
CONFIG_INET6_ESP=y
CONFIG_INET6_IPCOMP=y
CONFIG_IPV6_MIP6=y
CONFIG_IPV6_VTI=y
CONFIG_IPV6_GRE=y
CONFIG_IPV6_MULTIPLE_TABLES=y
CONFIG_NETFILTER=y
CONFIG_NF_CONNTRACK=y
CONFIG_NF_CONNTRACK_SECMARK=y
CONFIG_NF_CONNTRACK_EVENTS=y
CONFIG_NF_CONNTRACK_AMANDA=y
CONFIG_NF_CONNTRACK_FTP=y
CONFIG_NF_CONNTRACK_H323=y
CONFIG_NF_CONNTRACK_IRC=y
CONFIG_NF_CONNTRACK_NETBIOS_NS=y
CONFIG_NF_CONNTRACK_PPTP=y
CONFIG_NF_CONNTRACK_SANE=y
CONFIG_NF_CONNTRACK_TFTP=y
CONFIG_NF_CT_NETLINK=y
CONFIG_NETFILTER_XT_TARGET_CLASSIFY=y
CONFIG_NETFILTER_XT_TARGET_CONNMARK=y
CONFIG_NETFILTER_XT_TARGET_CONNSECMARK=y
CONFIG_NETFILTER_XT_TARGET_DSCP=y
CONFIG_NETFILTER_XT_TARGET_IDLETIMER=y
CONFIG_NETFILTER_XT_TARGET_MARK=y
CONFIG_NETFILTER_XT_TARGET_NFLOG=y
CONFIG_NETFILTER_XT_TARGET_NFQUEUE=y
CONFIG_NETFILTER_XT_TARGET_NOTRACK=y
CONFIG_NETFILTER_XT_TARGET_TEE=y
CONFIG_NETFILTER_XT_TARGET_TPROXY=y
CONFIG_NETFILTER_XT_TARGET_TRACE=y
CONFIG_NETFILTER_XT_TARGET_SECMARK=y
CONFIG_NETFILTER_XT_TARGET_TCPMSS=y
CONFIG_NETFILTER_XT_MATCH_BPF=y
CONFIG_NETFILTER_XT_MATCH_COMMENT=y
CONFIG_NETFILTER_XT_MATCH_CONNLIMIT=y
CONFIG_NETFILTER_XT_MATCH_CONNMARK=y
CONFIG_NETFILTER_XT_MATCH_CONNTRACK=y
CONFIG_NETFILTER_XT_MATCH_DSCP=y
CONFIG_NETFILTER_XT_MATCH_ESP=y
CONFIG_NETFILTER_XT_MATCH_HASHLIMIT=y
CONFIG_NETFILTER_XT_MATCH_HELPER=y
CONFIG_NETFILTER_XT_MATCH_IPRANGE=y
CONFIG_NETFILTER_XT_MATCH_LENGTH=y
CONFIG_NETFILTER_XT_MATCH_LIMIT=y
CONFIG_NETFILTER_XT_MATCH_MAC=y
CONFIG_NETFILTER_XT_MATCH_MARK=y
CONFIG_NETFILTER_XT_MATCH_MULTIPORT=y
CONFIG_NETFILTER_XT_MATCH_OWNER=y
CONFIG_NETFILTER_XT_MATCH_POLICY=y
CONFIG_NETFILTER_XT_MATCH_PKTTYPE=y
CONFIG_NETFILTER_XT_MATCH_QUOTA=y
CONFIG_NETFILTER_XT_MATCH_QUOTA2=y
CONFIG_NETFILTER_XT_MATCH_QUOTA2_LOG=y
CONFIG_NETFILTER_XT_MATCH_SOCKET=y
CONFIG_NETFILTER_XT_MATCH_STATE=y
CONFIG_NETFILTER_XT_MATCH_STATISTIC=y
CONFIG_NETFILTER_XT_MATCH_STRING=y
CONFIG_NETFILTER_XT_MATCH_TIME=y
CONFIG_NETFILTER_XT_MATCH_U32=y
CONFIG_IP_NF_IPTABLES=y
CONFIG_IP_NF_MATCH_ECN=y
CONFIG_IP_NF_MATCH_TTL=y
CONFIG_IP_NF_FILTER=y
CONFIG_IP_NF_TARGET_REJECT=y
CONFIG_IP_NF_NAT=y
CONFIG_IP_NF_TARGET_MASQUERADE=y
CONFIG_IP_NF_TARGET_NETMAP=y
CONFIG_IP_NF_TARGET_REDIRECT=y
CONFIG_IP_NF_MANGLE=y
CONFIG_IP_NF_RAW=y
CONFIG_IP_NF_SECURITY=y
CONFIG_IP_NF_ARPTABLES=y
CONFIG_IP_NF_ARPFILTER=y
CONFIG_IP_NF_ARP_MANGLE=y
CONFIG_IP6_NF_IPTABLES=y
CONFIG_IP6_NF_MATCH_RPFILTER=y
CONFIG_IP6_NF_FILTER=y
CONFIG_IP6_NF_TARGET_REJECT=y
CONFIG_IP6_NF_MANGLE=y
CONFIG_IP6_NF_RAW=y
CONFIG_TIPC=y
CONFIG_L2TP=y
CONFIG_BRIDGE=y
CONFIG_VLAN_8021Q=y
CONFIG_6LOWPAN=y
CONFIG_IEEE802154=y
CONFIG_IEEE802154_6LOWPAN=y
CONFIG_MAC802154=y
CONFIG_NET_SCHED=y
CONFIG_NET_SCH_HTB=y
CONFIG_NET_SCH_PRIO=y
CONFIG_NET_SCH_MULTIQ=y
CONFIG_NET_SCH_SFQ=y
CONFIG_NET_SCH_TBF=y
CONFIG_NET_SCH_NETEM=y
CONFIG_NET_SCH_CODEL=y
CONFIG_NET_SCH_FQ_CODEL=y
CONFIG_NET_SCH_FQ=y
CONFIG_NET_SCH_INGRESS=y
CONFIG_NET_CLS_BASIC=y
CONFIG_NET_CLS_FW=y
CONFIG_NET_CLS_U32=y
CONFIG_CLS_U32_MARK=y
CONFIG_NET_CLS_FLOW=y
CONFIG_NET_CLS_BPF=y
CONFIG_NET_CLS_MATCHALL=y
CONFIG_NET_EMATCH=y
CONFIG_NET_EMATCH_CMP=y
CONFIG_NET_EMATCH_NBYTE=y
CONFIG_NET_EMATCH_U32=y
CONFIG_NET_EMATCH_META=y
CONFIG_NET_EMATCH_TEXT=y
CONFIG_NET_CLS_ACT=y
CONFIG_NET_ACT_POLICE=y
CONFIG_NET_ACT_GACT=y
CONFIG_NET_ACT_MIRRED=y
CONFIG_NET_ACT_SKBEDIT=y
CONFIG_NET_ACT_BPF=y
CONFIG_VSOCKETS=y
CONFIG_KNOX_NCM=y
CONFIG_CGROUP_NET_PRIO=y
CONFIG_CAN=y
CONFIG_BT=y
CONFIG_BT_RFCOMM=y
CONFIG_BT_RFCOMM_TTY=y
CONFIG_BT_HIDP=y
CONFIG_BT_HCIBTSDIO=y
CONFIG_BT_HCIUART=y
CONFIG_BT_HCIUART_LL=y
CONFIG_BT_HCIUART_BCM=y
CONFIG_BT_HCIUART_QCA=y
CONFIG_CFG80211=m
CONFIG_RFKILL=y
CONFIG_NET_9P=y
CONFIG_NFC=y
CONFIG_SAMSUNG_NFC=m
CONFIG_NFC_PVDD_LATE_ENABLE=y
CONFIG_ESE_USE_TZ_API=y
CONFIG_SEC_NFC_LOGGER=y
CONFIG_NFC_PN547=y
CONFIG_NFC_FEATURE_SN100U=y
CONFIG_PCI=y
CONFIG_PCIEPORTBUS=y
CONFIG_PCIEAER=y
CONFIG_PCI_IOV=y
CONFIG_PCI_HOST_GENERIC=y
CONFIG_PCIE_DW_PLAT_EP=y
CONFIG_PCIE_QCOM=y
CONFIG_PCIE_KIRIN=y
CONFIG_PCI_ENDPOINT=y
CONFIG_EXTRA_FIRMWARE="tsp_ovt/td4160_a13x_boe.bin tsp_novatek/nt36672_a14x_2ndbr_tianma.bin tsp_novatek/nt36672_a14x_2ndbr_tianma_mp.bin tsp_novatek/nt36672_a14x_tianma.bin tsp_novatek/nt36672_a14x_tianma_mp.bin"
CONFIG_EXTRA_FIRMWARE_DIR="firmware"
CONFIG_FW_LOADER_USER_HELPER=y
# CONFIG_FW_CACHE is not set
# CONFIG_SUN50I_DE2_BUS is not set
# CONFIG_SUNXI_RSB is not set
CONFIG_ARM_SCMI_PROTOCOL=y
CONFIG_ARM_SCMI_TRANSPORT_VIRTIO=y
# CONFIG_ARM_SCMI_POWER_DOMAIN is not set
CONFIG_ARM_SCPI_PROTOCOL=y
# CONFIG_ARM_SCPI_POWER_DOMAIN is not set
# CONFIG_EFI_ARMSTUB_DTB_LOADER is not set
CONFIG_GNSS=y
CONFIG_BLK_DEV_LOOP=y
CONFIG_BLK_DEV_LOOP_MIN_COUNT=16
CONFIG_BLK_DEV_RAM=y
CONFIG_BLK_DEV_RAM_SIZE=8192
CONFIG_SRAM=y
CONFIG_UID_SYS_STATS=y
CONFIG_SCSC_CORE=m
CONFIG_SCSC_WLBT_CONFIG_PLATFORM="rice_s620_erd"
CONFIG_SCSC_CORE_FW_LOCATION="/vendor/firmware/wifi"
# CONFIG_SCSC_SMAPPER is not set
CONFIG_SCSC_WLBTD=y
CONFIG_SCSC_PLATFORM=m
CONFIG_SCSC_CM_MX_CLIENT_TEST=m
CONFIG_SCSC_FM=m
CONFIG_SCSC_MMAP=m
CONFIG_SCSC_LOGRING=m
CONFIG_SCSC_STATIC_RING_SIZE=4194304
# CONFIG_SCSC_LOGRING_DEBUGFS is not set
CONFIG_SCSC_MX450_GDB_SUPPORT=y
CONFIG_SCSC_LAST_PANIC_IN_DRAM=y
CONFIG_WLBT_WARN_ON=y
CONFIG_SCSC_BT=m
CONFIG_TZDEV=m
CONFIG_SAMSUNG_GKI_KERNEL=y
CONFIG_TZDEV_IWI_EVENT=260
CONFIG_TZDEV_IWI_PANIC=261
CONFIG_TZDEV_SWD_PANIC_IS_CRITICAL=y
CONFIG_TZLOG=y
CONFIG_TZLOG_PG_CNT=8
CONFIG_TZDEV_SK_MULTICORE=y
CONFIG_TZIRS=y
CONFIG_TZ_BOOT_LOG=y
CONFIG_TEEGRIS_VERSION=5
# CONFIG_TZDEV_CPUFREQ_TRANSITION is not set
CONFIG_SAMSUNG_TUI=m
CONFIG_SCSI=y
CONFIG_UFS_SRPMB=m
# CONFIG_SCSI_PROC_FS is not set
CONFIG_BLK_DEV_SD=y
CONFIG_SCSI_UFSHCD=y
CONFIG_SCSI_UFSHCD_PCI=y
CONFIG_SCSI_UFSHCD_PLATFORM=y
CONFIG_SCSI_UFS_DWC_TC_PLATFORM=y
CONFIG_SCSI_UFS_HISI=y
CONFIG_SCSI_UFS_BSG=y
CONFIG_SCSI_UFS_EXYNOS=m
CONFIG_SCSI_UFS_EXYNOS_SRPMB=y
CONFIG_SCSI_UFS_EXYNOS_FMP=y
CONFIG_SCSI_UFS_CRYPTO=y
CONFIG_SCSI_UFS_HPB=y
CONFIG_SEC_UFS_FEATURE=y
CONFIG_SEC_UFS_CMD_LOGGING=y
CONFIG_MD=y
CONFIG_BLK_DEV_DM=y
CONFIG_DM_CRYPT=y
CONFIG_DM_DEFAULT_KEY=y
CONFIG_DM_SNAPSHOT=y
CONFIG_DM_INIT=y
CONFIG_DM_UEVENT=y
CONFIG_DM_VERITY=y
CONFIG_DM_VERITY_FEC=y
CONFIG_DM_BOW=y
CONFIG_NETDEVICES=y
CONFIG_DUMMY=y
CONFIG_WIREGUARD=y
CONFIG_IFB=y
CONFIG_MACSEC=y
CONFIG_TUN=y
CONFIG_VETH=y
CONFIG_PPP=y
CONFIG_PPP_BSDCOMP=y
CONFIG_PPP_DEFLATE=y
CONFIG_PPP_MPPE=y
CONFIG_PPTP=y
CONFIG_PPPOL2TP=y
CONFIG_USB_RTL8150=y
CONFIG_USB_RTL8152=y
CONFIG_USB_USBNET=y
CONFIG_USB_NET_CDC_EEM=y
CONFIG_USB_NET_CDC_MBIM=m
CONFIG_USB_NET_SMSC75XX=m
CONFIG_USB_NET_SMSC95XX=m
# CONFIG_USB_NET_NET1080 is not set
# CONFIG_USB_NET_CDC_SUBSET is not set
# CONFIG_USB_NET_ZAURUS is not set
CONFIG_USB_NET_AQC111=y
# CONFIG_WLAN_VENDOR_ADMTEK is not set
# CONFIG_WLAN_VENDOR_ATH is not set
# CONFIG_WLAN_VENDOR_ATMEL is not set
# CONFIG_WLAN_VENDOR_BROADCOM is not set
# CONFIG_WLAN_VENDOR_CISCO is not set
# CONFIG_WLAN_VENDOR_INTEL is not set
# CONFIG_WLAN_VENDOR_INTERSIL is not set
# CONFIG_WLAN_VENDOR_MARVELL is not set
# CONFIG_WLAN_VENDOR_MEDIATEK is not set
# CONFIG_WLAN_VENDOR_RALINK is not set
# CONFIG_WLAN_VENDOR_REALTEK is not set
# CONFIG_WLAN_VENDOR_RSI is not set
# CONFIG_WLAN_VENDOR_ST is not set
# CONFIG_WLAN_VENDOR_TI is not set
# CONFIG_WLAN_VENDOR_ZYDAS is not set
# CONFIG_WLAN_VENDOR_QUANTENNA is not set
CONFIG_SCSC_WLAN=m
# CONFIG_SCSC_WLAN_HIP4_PROFILING is not set
CONFIG_SCSC_WIFILOGGER=m
# CONFIG_SCSC_WIFILOGGER_DEBUGFS is not set
CONFIG_SCSC_WLAN_MAX_INTERFACES=12
CONFIG_SCSC_WLAN_WIFI_SHARING=y
CONFIG_SCSC_WLAN_ENABLE_MAC_RANDOMISATION=y
CONFIG_SCSC_AP_INTERFACE_NAME="swlan0"
CONFIG_SCSC_WLAN_MHS_STATIC_INTERFACE=y
CONFIG_SCSC_WLAN_TAS=y
CONFIG_INPUT_EVDEV=y
CONFIG_KEYBOARD_GPIO=y
CONFIG_KEYBOARD_SAMSUNG_PMIC=m
CONFIG_KEYBOARD_S2MPU15_8535=m
# CONFIG_MOUSE_PS2 is not set
CONFIG_INPUT_JOYSTICK=y
CONFIG_JOYSTICK_XPAD=y
CONFIG_JOYSTICK_XPAD_FF=y
CONFIG_JOYSTICK_XPAD_LEDS=y
CONFIG_INPUT_TABLET=y
CONFIG_TABLET_USB_ACECAD=m
CONFIG_TABLET_USB_AIPTEK=m
CONFIG_TABLET_USB_HANWANG=m
CONFIG_TABLET_USB_KBTAB=m
CONFIG_INPUT_TOUCHSCREEN=y
CONFIG_INPUT_MISC=y
CONFIG_INPUT_UINPUT=y
# CONFIG_VT is not set
# CONFIG_LEGACY_PTYS is not set
CONFIG_SERIAL_8250=y
# CONFIG_SERIAL_8250_DEPRECATED_OPTIONS is not set
CONFIG_SERIAL_8250_CONSOLE=y
# CONFIG_SERIAL_8250_EXAR is not set
CONFIG_SERIAL_8250_NR_UARTS=32
CONFIG_SERIAL_8250_RUNTIME_UARTS=0
CONFIG_SERIAL_8250_DW=y
CONFIG_SERIAL_OF_PLATFORM=y
CONFIG_SERIAL_AMBA_PL011=y
CONFIG_SERIAL_AMBA_PL011_CONSOLE=y
CONFIG_SERIAL_SAMSUNG=y
CONFIG_SERIAL_SAMSUNG_CONSOLE=y
CONFIG_SERIAL_EXYNOS=m
CONFIG_SERIAL_QCOM_GENI=y
# CONFIG_SERIAL_QCOM_GENI_CONSOLE_DEFAULT_ENABLED is not set
CONFIG_SERIAL_QCOM_GENI_CONSOLE=y
CONFIG_SERIAL_SPRD=y
CONFIG_SERIAL_SPRD_CONSOLE=y
CONFIG_HVC_DCC=y
CONFIG_SERIAL_DEV_BUS=y
CONFIG_HW_RANDOM=y
# CONFIG_DEVMEM is not set
# CONFIG_DEVPORT is not set
# CONFIG_I2C_COMPAT is not set
CONFIG_I2C_CHARDEV=m
# CONFIG_I2C_HELPER_AUTO is not set
CONFIG_I2C_EXYNOS5=m
CONFIG_EXYNOS_ACPM_MFD_BUS=m
CONFIG_I3C=y
CONFIG_I3C_HCI_EXYNOS=m
CONFIG_SPI=y
CONFIG_SPI_MEM=y
CONFIG_SPI_S3C64XX=m
CONFIG_SPI_SPIDEV=m
CONFIG_SPMI=y
# CONFIG_SPMI_MSM_PMIC_ARB is not set
CONFIG_PINCTRL_SAMSUNG=m
# CONFIG_PINCTRL_SUN8I_H3_R is not set
# CONFIG_PINCTRL_SUN50I_A64 is not set
# CONFIG_PINCTRL_SUN50I_A64_R is not set
# CONFIG_PINCTRL_SUN50I_H5 is not set
# CONFIG_PINCTRL_SUN50I_H6 is not set
# CONFIG_PINCTRL_SUN50I_H6_R is not set
CONFIG_PINCTRL_SAMSUNG_PMIC=m
CONFIG_PINCTRL_SAMSUNG_S2MPU15_8535=m
CONFIG_GPIO_GENERIC_PLATFORM=y
CONFIG_POWER_RESET_HISI=y
CONFIG_POWER_RESET_SYSCON=y
CONFIG_POWER_RESET_EXYNOS=m
# CONFIG_HWMON is not set
CONFIG_THERMAL=y
CONFIG_THERMAL_NETLINK=y
CONFIG_THERMAL_STATISTICS=y
CONFIG_THERMAL_EMERGENCY_POWEROFF_DELAY_MS=100
CONFIG_THERMAL_WRITABLE_TRIPS=y
CONFIG_THERMAL_GOV_USER_SPACE=y
CONFIG_THERMAL_GOV_POWER_ALLOCATOR=y
CONFIG_CPU_THERMAL=y
CONFIG_CPU_IDLE_THERMAL=y
CONFIG_THERMAL_EMULATION=y
CONFIG_EXYNOS_THERMAL_V2=m
CONFIG_EXYNOS_ACPM_THERMAL=m
CONFIG_GPU_THERMAL=m
CONFIG_ISP_THERMAL=m
CONFIG_EXYNOS_CPU_THERMAL=m
CONFIG_WATCHDOG=y
CONFIG_WATCHDOG_CORE=y
CONFIG_S3C2410_WATCHDOG=m
CONFIG_S3C2410_SHUTDOWN_REBOOT=y
CONFIG_S3C2410_BUILTIN_WATCHDOG=y
CONFIG_MFD_ACT8945A=y
CONFIG_MFD_SAMSUNG_PMIC=m
CONFIG_MFD_S2MPU15_8535=m
CONFIG_MFD_S2MPA05_8535=m
CONFIG_REGULATOR_FIXED_VOLTAGE=y
CONFIG_DRV_SAMSUNG_PMIC=m
CONFIG_REGULATOR_S2MPU15_8535=m
CONFIG_REGULATOR_S2MPA05_8535=m
CONFIG_RC_CORE=y
# CONFIG_RC_MAP is not set
CONFIG_LIRC=y
CONFIG_BPF_LIRC_MODE2=y
CONFIG_RC_DECODERS=y
CONFIG_RC_DEVICES=y
CONFIG_MEDIA_CEC_RC=y
# CONFIG_MEDIA_ANALOG_TV_SUPPORT is not set
# CONFIG_MEDIA_DIGITAL_TV_SUPPORT is not set
# CONFIG_MEDIA_RADIO_SUPPORT is not set
# CONFIG_MEDIA_SDR_SUPPORT is not set
# CONFIG_MEDIA_TEST_SUPPORT is not set
CONFIG_VIDEO_V4L2_SUBDEV_API=y
CONFIG_MEDIA_USB_SUPPORT=y
CONFIG_USB_VIDEO_CLASS=y
CONFIG_USB_GSPCA=y
CONFIG_RADIO_S5E8535=m
CONFIG_RADIO_S620=m
CONFIG_V4L_PLATFORM_DRIVERS=y
CONFIG_VIDEO_EXYNOS_MFC=m
CONFIG_VIDEO_EXYNOS_PABLO_ISP=m
CONFIG_PABLO_OBTE_SUPPORT=m
CONFIG_VIDEO_EXYNOS_CAMERA_POSTPROCESS=m
CONFIG_VIDEO_EXYNOS_CAMERA_POSTPROCESS_GDC=m
CONFIG_CAMERA_PP_GDC_V2_2_0_OBJ=m
CONFIG_VIDEO_EXYNOS_CAMERA_POSTPROCESS_VRA=m
CONFIG_CAMERA_PP_VRA_V6_0_0_OBJ=m
CONFIG_VIDEO_EXYNOS_PABLO_LIB_VOTF=m
CONFIG_CAMERA_VENDER_MCD_V2=y
CONFIG_CAMERA_EEPROM_SUPPORT_REAR=m
CONFIG_CAMERA_OTPROM_SUPPORT_FRONT=m
CONFIG_CAMERA_AAW_A14X=y
CONFIG_CAMERA_CIS_3L6_OBJ=m
CONFIG_CAMERA_CIS_HI1336_OBJ=m
CONFIG_CAMERA_CIS_JN1_OBJ=m
CONFIG_CAMERA_CIS_SC201_OBJ=m
CONFIG_CAMERA_CIS_GC02M1_OBJ=m
CONFIG_CAMERA_CIS_GC02M2_OBJ=m
CONFIG_CAMERA_ACT_GT9778_OBJ=m
CONFIG_CAMERA_FLASH_SM5714_OBJ=m
CONFIG_V4L_MEM2MEM_DRIVERS=y
CONFIG_VIDEO_EXYNOS_SCALER=m
CONFIG_VIDEO_EXYNOS_SMFC=m
CONFIG_MALI_MIDGARD=m
CONFIG_MALI_EXYNOS_CLOCK=y
CONFIG_MALI_EXYNOS_DVFS=y
CONFIG_MALI_EXYNOS_PM=y
CONFIG_MALI_EXYNOS_RTPM=y
# CONFIG_MALI_DEBUG_SYS is not set
CONFIG_MALI_EXYNOS_QOS=y
CONFIG_MALI_EXYNOS_THERMAL=y
CONFIG_MALI_EXYNOS_BTS_MO=y
CONFIG_MALI_EXYNOS_SECURE_RENDERING_ARM=y
CONFIG_MALI_EXYNOS_DEBUG=y
CONFIG_MALI_EXYNOS_CL_BOOST=y
CONFIG_MALI_TSG=y
CONFIG_EXYNOS_SOC_NAME="exynos"
# CONFIG_MALI_EXYNOS_UNIT_TESTS is not set
# CONFIG_MALI_EXYNOS_DEBUG_FAULT_DUMP is not set
CONFIG_MALI_EXYNOS_GPU_MEM_DUMP=y
# CONFIG_MALI_DEVFREQ is not set
# CONFIG_MALI_GATOR_SUPPORT is not set
CONFIG_MALI_MIDGARD_ENABLE_TRACE=y
CONFIG_MALI_EXPERT=y
CONFIG_MALI_HW_ERRATA_1485982_NOT_AFFECTED=y
# CONFIG_VGA_ARB is not set
CONFIG_DRM=y
CONFIG_DRM_SAMSUNG_DPU=m
CONFIG_EXYNOS_DMA_DSIMFC=y
CONFIG_EXYNOS_PLL_SLEEP=y
CONFIG_EXYNOS_CMD_SVSYNC=y
CONFIG_EXYNOS_CMD_SVSYNC_ONOFF=y
CONFIG_DRM_PANEL_MCD_COMMON=m
CONFIG_DRM_MCD_COMMON=y
CONFIG_BACKLIGHT_CLASS_DEVICE=y
CONFIG_SOUND=y
CONFIG_SND=y
CONFIG_SND_HRTIMER=y
# CONFIG_SND_SUPPORT_OLD_API is not set
# CONFIG_SND_VERBOSE_PROCFS is not set
# CONFIG_SND_DRIVERS is not set
CONFIG_SND_USB_AUDIO=y
CONFIG_SND_EXYNOS_USB_AUDIO=y
CONFIG_SND_EXYNOS_USB_AUDIO_GIC=y
CONFIG_SND_SOC=y
CONFIG_SND_SOC_SAMSUNG=m
CONFIG_SND_SOC_SAMSUNG_EXYNOS8535_RT5691=m
CONFIG_SND_SOC_SAMSUNG_EXYNOS8535_SMA1305=m
CONFIG_SND_SOC_SAMSUNG_AUDIO=m
CONFIG_SND_SOC_SAMSUNG_ABOX_CHANGE_RMEM_SIZE=m
CONFIG_HID_BATTERY_STRENGTH=y
CONFIG_HIDRAW=y
CONFIG_UHID=y
CONFIG_HID_A4TECH=m
CONFIG_HID_ACRUX=m
CONFIG_HID_ACRUX_FF=y
CONFIG_HID_APPLE=y
CONFIG_HID_BELKIN=m
CONFIG_HID_CHERRY=m
CONFIG_HID_CHICONY=m
CONFIG_HID_PRODIKEYS=y
CONFIG_HID_CYPRESS=m
CONFIG_HID_DRAGONRISE=m
CONFIG_DRAGONRISE_FF=y
CONFIG_HID_EMS_FF=m
CONFIG_HID_ELECOM=y
CONFIG_HID_EZKEY=m
CONFIG_HID_HOLTEK=m
CONFIG_HID_KEYTOUCH=m
CONFIG_HID_UCLOGIC=y
CONFIG_HID_WALTOP=m
CONFIG_HID_GYRATION=m
CONFIG_HID_TWINHAN=m
CONFIG_HID_KENSINGTON=m
CONFIG_HID_LCPOWER=m
CONFIG_HID_LOGITECH=y
CONFIG_HID_LOGITECH_DJ=y
CONFIG_LOGITECH_FF=y
CONFIG_LOGIRUMBLEPAD2_FF=y
CONFIG_HID_MAGICMOUSE=y
CONFIG_HID_MICROSOFT=y
CONFIG_HID_MONTEREY=m
CONFIG_HID_MULTITOUCH=y
CONFIG_HID_NINTENDO=y
CONFIG_HID_NTRIG=m
CONFIG_HID_ORTEK=m
CONFIG_HID_PANTHERLORD=m
CONFIG_PANTHERLORD_FF=y
CONFIG_HID_PETALYNX=m
CONFIG_HID_PICOLCD=y
CONFIG_HID_PLANTRONICS=y
CONFIG_HID_PLAYSTATION=y
CONFIG_PLAYSTATION_FF=y
CONFIG_HID_PRIMAX=m
CONFIG_HID_ROCCAT=y
CONFIG_HID_SAITEK=m
CONFIG_HID_SAMSUNG=y
CONFIG_HID_SONY=y
CONFIG_SONY_FF=y
CONFIG_HID_SPEEDLINK=m
CONFIG_HID_STEAM=y
CONFIG_HID_SUNPLUS=m
CONFIG_HID_GREENASIA=m
CONFIG_GREENASIA_FF=y
CONFIG_HID_SMARTJOYPLUS=m
CONFIG_SMARTJOYPLUS_FF=y
CONFIG_HID_TIVO=m
CONFIG_HID_TOPSEED=m
CONFIG_HID_THRUSTMASTER=m
CONFIG_HID_WACOM=y
CONFIG_HID_WIIMOTE=y
CONFIG_HID_ZEROPLUS=m
CONFIG_HID_ZYDACRON=m
CONFIG_USB_HIDDEV=y
CONFIG_USB_ANNOUNCE_NEW_DEVICES=y
CONFIG_USB_OTG=y
CONFIG_USB_HOST_CERTIFICATION=y
CONFIG_USB_XHCI_HCD=y
CONFIG_USB_XHCI_PCI_RENESAS=y
CONFIG_USB_XHCI_EXYNOS=m
CONFIG_USB_XHCI_EXYNOS_AUDIO=y
CONFIG_USB_EHCI_HCD=y
CONFIG_USB_EHCI_ROOT_HUB_TT=y
CONFIG_USB_EHCI_HCD_PLATFORM=y
CONFIG_USB_ACM=y
CONFIG_USB_PRINTER=m
CONFIG_USB_STORAGE=y
CONFIG_USB_UAS=y
CONFIG_USB_DWC3=y
CONFIG_USB_DWC3_EXYNOS_MODULE=m
CONFIG_USB_EXYNOS_TPMON_MODULE=m
CONFIG_USB_SERIAL=m
CONFIG_USB_LINK_LAYER_TEST=m
CONFIG_USB_GADGET=y
CONFIG_USB_CONFIGFS=y
CONFIG_USB_CONFIGFS_UEVENT=y
CONFIG_USB_CONFIGFS_SERIAL=y
CONFIG_USB_CONFIGFS_ACM=y
CONFIG_USB_CONFIGFS_NCM=y
CONFIG_USB_CONFIGFS_ECM=y
CONFIG_USB_CONFIGFS_RNDIS=y
CONFIG_USB_CONFIGFS_EEM=y
CONFIG_USB_CONFIGFS_MASS_STORAGE=y
CONFIG_USB_CONFIGFS_F_FS=y
CONFIG_USB_CONFIGFS_F_DM=m
CONFIG_USB_CONFIGFS_F_CONN_GADGET=m
CONFIG_USB_CONFIGFS_F_SS_MON_GADGET=m
CONFIG_USB_CONFIGFS_F_ACC=y
CONFIG_USB_CONFIGFS_F_AUDIO_SRC=y
CONFIG_USB_CONFIGFS_F_UAC2=y
CONFIG_USB_CONFIGFS_F_MIDI=y
CONFIG_USB_CONFIGFS_F_HID=y
CONFIG_USB_CONFIGFS_F_UVC=y
CONFIG_TYPEC=y
CONFIG_TYPEC_TCPM=y
CONFIG_TYPEC_TCPCI=y
CONFIG_TYPEC_UCSI=y
CONFIG_USB_HOST_NOTIFY=y
CONFIG_USB_NOTIFY_LAYER=m
CONFIG_USB_NOTIFIER=m
CONFIG_USB_DEBUG_DETAILED_LOG=y
CONFIG_USB_EXTERNAL_NOTIFY=y
CONFIG_USB_NOTIFY_PROC_LOG=y
CONFIG_USB_HOST_SAMSUNG_FEATURE=y
CONFIG_USB_HW_PARAM=y
CONFIG_USB_INTERFACE_LPM_LIST=y
CONFIG_USB_HOST_CERTI=y
CONFIG_MMC=y
# CONFIG_PWRSEQ_EMMC is not set
# CONFIG_PWRSEQ_SIMPLE is not set
CONFIG_MMC_CRYPTO=y
CONFIG_MMC_SDHCI=y
CONFIG_MMC_SDHCI_PLTFM=y
CONFIG_MMC_DW=m
CONFIG_MMC_DW_EXYNOS=m
CONFIG_MMC_DW_DEBUG=m
CONFIG_SEC_MMC_FEATURE=y
CONFIG_LEDS_CLASS_FLASH=y
CONFIG_LEDS_CLASS_MULTICOLOR=y
CONFIG_LEDS_SM5714=m
CONFIG_LEDS_TRIGGER_TIMER=y
CONFIG_LEDS_TRIGGER_TRANSIENT=y
CONFIG_EDAC=y
CONFIG_RTC_CLASS=y
CONFIG_RTC_DRV_PL030=y
CONFIG_RTC_DRV_PL031=y
CONFIG_RTC_SAMSUNG_PMIC=m
CONFIG_RTC_DRV_S2MPU15_8535=m
CONFIG_PL330_DMA=m
CONFIG_SAMSUNG_DMADEV=m
CONFIG_DMABUF_HEAPS=y
CONFIG_DMABUF_SYSFS_STATS=y
CONFIG_DMABUF_SAMSUNG_HEAPS=m
CONFIG_DMABUF_HEAPS_SAMSUNG_CHUNK=y
CONFIG_DMABUF_HEAPS_SAMSUNG_CMA=y
CONFIG_DMABUF_HEAPS_SAMSUNG_CARVEOUT=y
CONFIG_DMABUF_HEAPS_SAMSUNG_HPA=y
CONFIG_DMABUF_HEAPS_SAMSUNG_SYSTEM=y
CONFIG_UIO=y
CONFIG_VHOST_VSOCK=y
CONFIG_STAGING=y
CONFIG_ASHMEM=y
CONFIG_DEBUG_KINFO=y
CONFIG_SAMSUNG_FREECESS=y
CONFIG_ANDROID_SWITCH=m
CONFIG_NANOHUB=m
CONFIG_COMMON_CLK_SCPI=y
CONFIG_COMPOSITE_CLK_SAMSUNG=m
# CONFIG_CLK_SUNXI is not set
# CONFIG_SUNXI_CCU is not set
CONFIG_HWSPINLOCK=y
# CONFIG_SUN50I_ERRATUM_UNKNOWN1 is not set
CONFIG_CLKSRC_EXYNOS_MCT_V3=m
CONFIG_MAILBOX=y
CONFIG_IOMMU_IO_PGTABLE_ARMV7S=y
CONFIG_SAMSUNG_IOMMU=m
CONFIG_REMOTEPROC=y
CONFIG_REMOTEPROC_CDEV=y
CONFIG_RPMSG_CHAR=y
CONFIG_QCOM_GENI_SE=y
CONFIG_SOC_S5E8535=y
CONFIG_EXYNOS_PMU_IF=m
CONFIG_CAL_IF=m
CONFIG_GNSS_PMUCAL=m
CONFIG_CHUB_PMUCAL=m
CONFIG_EXYNOS_FLEXPMU_DBG=m
CONFIG_PMUCAL_CMU_INIT=y
CONFIG_EXYNOS_PD=m
CONFIG_EXYNOS_PD_DBG=m
CONFIG_EXYNOS_BCM_DBG=m
CONFIG_EXYNOS_BCM_TIME_SYNC=y
CONFIG_EXYNOS_ACPM=m
CONFIG_EXYNOS_DVFS_MANAGER=m
CONFIG_ACPM_DVFS=m
CONFIG_ECT=m
CONFIG_EXYNOS_PM=m
CONFIG_EXYNOS_CPUHP=m
CONFIG_EXYNOS_UFCC=m
CONFIG_EXYNOS_AFM=m
CONFIG_EXYNOS_MFD_SPMI=y
CONFIG_EXYNOS_ACPM_PLGDBG=m
CONFIG_EXYNOS_DEBUG=y
CONFIG_DEBUG_SNAPSHOT=m
CONFIG_DEBUG_SNAPSHOT_API=y
CONFIG_DEBUG_SNAPSHOT_DEBUG_KINFO=m
CONFIG_EXYNOS_ITMON_V2=m
CONFIG_EXYNOS_CORESIGHT=m
CONFIG_EXYNOS_ECC_HANDLER=m
CONFIG_EXYNOS_HARDLOCKUP_WATCHDOG=m
CONFIG_EXYNOS_ADV_TRACER=m
CONFIG_EXYNOS_ADV_TRACER_S2D=m
CONFIG_EXYNOS_EHLD=m
CONFIG_EXYNOS_SSLD=m
CONFIG_EXYNOS_GETCPUSTATE=m
# CONFIG_EXYNOS_HDCP2 is not set
CONFIG_EXYNOS_MEMORY_LOGGER=m
CONFIG_EXYNOS_IMGLOADER=m
CONFIG_EXYNOS_SYSTEM_EVENT=m
CONFIG_EXYNOS_EL2=m
CONFIG_EXYNOS_S2MPU=m
CONFIG_EXYNOS_CHIPID_V2=m
CONFIG_EXYNOS_USI_V2=m
CONFIG_EXYNOS_VARIANT1=y
CONFIG_EXYNOS_MODEM_IF=m
CONFIG_SEC_MODEM_S5000AP=m
CONFIG_LINK_DEVICE_WITH_SBD_ARCH=m
CONFIG_CP_PKTPROC=m
CONFIG_CP_PKTPROC_UL=m
CONFIG_CP_BTL=m
CONFIG_MODEM_IF_QOS=m
CONFIG_CPIF_TP_MONITOR=m
CONFIG_EXYNOS_DIT=m
CONFIG_EXYNOS_DIT_VERSION=0x02020000
CONFIG_REINIT_VSS=m
CONFIG_VERIFY_VSS=m
CONFIG_CPIF_DIRECT_DM=m
CONFIG_CPIF_VENDOR_HOOK=m
CONFIG_CP_RESET_NOTI=y
CONFIG_EXYNOS_GNSS_IF=m
CONFIG_DEVFREQ_GOV_PERFORMANCE=y
CONFIG_DEVFREQ_GOV_POWERSAVE=y
CONFIG_DEVFREQ_GOV_USERSPACE=y
CONFIG_DEVFREQ_GOV_PASSIVE=y
CONFIG_EXYNOS_ALT_DVFS=m
CONFIG_PM_DEVFREQ_EVENT=y
CONFIG_IIO=y
CONFIG_IIO_BUFFER=y
CONFIG_IIO_TRIGGERED_BUFFER=y
CONFIG_ADC_SAMSUNG_PMIC=m
CONFIG_S2MPU15_ADC_8535=m
CONFIG_PWM=y
CONFIG_PWM_SAMSUNG=m
CONFIG_EXYNOS_GIC=y
CONFIG_ARM_GIC_VENDORHOOK=m
CONFIG_PHY_EXYNOS_USBDRD=m
CONFIG_PHY_EXYNOS_MIPI=m
CONFIG_PHY_EXYNOS_MIPI_DSIM=m
CONFIG_POWERCAP=y
CONFIG_IDLE_INJECT=y
CONFIG_ANDROID=y
CONFIG_ANDROID_BINDER_IPC=y
CONFIG_ANDROID_BINDERFS=y
CONFIG_ANDROID_DEBUG_SYMBOLS=y
CONFIG_ANDROID_VENDOR_HOOKS=y
CONFIG_LIBNVDIMM=y
# CONFIG_ND_BLK is not set
CONFIG_STM_PROTO_BASIC=y
CONFIG_INTERCONNECT=y
CONFIG_EXYNOS_BTS=m
# CONFIG_TRUSTONIC_TEE is not set
CONFIG_SEC_DEBUG=m
CONFIG_SEC_REBOOT=m
CONFIG_SEC_PMIC_PWRKEY_DTNAME="s2mpu15-keys"
CONFIG_SEC_KEY_NOTIFIER=m
CONFIG_SEC_BOOTSTAT=m
CONFIG_DRV_SAMSUNG=m
CONFIG_SAMSUNG_PRODUCT_SHIP=y
CONFIG_SEC_PM=y
CONFIG_SEC_PM_DEBUG=m
CONFIG_ARGOS=m
CONFIG_SEC_PANEL_NOTIFIER_V2=m
CONFIG_MFD_S2MF301=m
CONFIG_MUIC_PLATFORM=m
CONFIG_MUIC_SUPPORT_POWERMETER=y
CONFIG_HV_MUIC_VOLTAGE_CTRL=y
CONFIG_MUIC_SUPPORT_PRSWAP=y
CONFIG_FUELGAUGE_S2MF301=m
CONFIG_UI_SOC_PROLONGING=y
CONFIG_DEV_RIL_BRIDGE=m
CONFIG_SEC_VIBRATOR=m
CONFIG_SEC_VIB_NOTIFIER=y
CONFIG_SHUB=m
CONFIG_SHUB_MODULE=y
CONFIG_SUPPORT_DROPDUMP=m
CONFIG_USDM_PANEL_TFT_COMMON=m
CONFIG_USDM_PANEL_NT36672C_A14X_01=m
CONFIG_USDM_PANEL_FT8720_M14X_01=m
CONFIG_USDM_PANEL_NT36672C_M14X_00=m
CONFIG_SEC_INPUT_BOOSTER=m
CONFIG_SEC_INPUT_BOOSTER_SLSI=y
CONFIG_VBUS_NOTIFIER=m
CONFIG_SEC_STI=y
CONFIG_SB_CORE=m
CONFIG_SB_PQUEUE=y
CONFIG_SB_NOTIFY=y
CONFIG_SB_SYSFS=y
CONFIG_SB_VOTE=y
CONFIG_USE_MUIC=y
CONFIG_MUIC_NOTIFIER=m
CONFIG_MUIC_HV=y
CONFIG_MUIC_SUPPORT_PDIC=y
CONFIG_HICCUP_CHARGER=y
CONFIG_MUIC_AFC_RETRY=y
CONFIG_MUIC_COMMON_SYSFS=y
CONFIG_MUIC_USE_MODULE_PARAM=y
CONFIG_HICCUP_CC_DISABLE=y
CONFIG_PDIC_S2MF301=m
CONFIG_S2MF301_PDIC_TRY_SNK=y
CONFIG_VIBRATOR_VIB_INFO=m
CONFIG_USB_TYPEC_MANAGER_NOTIFIER=m
CONFIG_IF_CB_MANAGER=m
CONFIG_INPUT_SEC_INPUT=m
CONFIG_SEC_DEBUG_TSP_LOG=m
CONFIG_SENSORS_FINGERPRINT=m
CONFIG_FINGERPRINT_SECURE=y
CONFIG_SENSORS_FINGERPRINT_MODULE=y
CONFIG_SENSORS_FINGERPRINT_LSI=y
CONFIG_SENSORS_GW3X=m
CONFIG_PDIC_SLSI_NON_MCU=m
CONFIG_PDIC_PD30=y
CONFIG_SUPPORT_USB_TYPEC_OPS=y
CONFIG_CHARGER_SM5714=m
CONFIG_USDM_PANEL=m
CONFIG_USDM_PANEL_DISPLAY_MODE=y
CONFIG_USDM_BLIC_I2C=y
CONFIG_USDM_PANEL_BLIC=y
CONFIG_USDM_PANEL_ID_READ_REG_DADBDC=y
CONFIG_USDM_PANEL_JSON=y
CONFIG_CHARGER_S2MF301=m
CONFIG_PM_S2MF301=m
CONFIG_LSI_IFPMIC=y
CONFIG_PDIC_NOTIFIER=m
CONFIG_PDIC_USE_MODULE_PARAM=y
CONFIG_SEC_ABC=m
CONFIG_SEC_ABC_COMMON=m
CONFIG_SEC_ABC_SPEC_TYPE1=m
CONFIG_SEC_ABC_MOTTO=m
CONFIG_SEC_ABC_HUB=m
CONFIG_SEC_ABC_HUB_CORE=m
CONFIG_SEC_ABC_HUB_BOOTC=m
CONFIG_MUIC_S2MF301=m
CONFIG_TOP_S2MF301=y
CONFIG_HV_MUIC_S2MF301_AFC=m
CONFIG_MUIC_S2MF301_RID=y
CONFIG_FUELGAUGE_SM5714=m
CONFIG_CHARGER_SM5451=m
CONFIG_MFD_SM5714=m
CONFIG_TOUCHSCREEN_NOVATEK_NT36523_SPI=m
CONFIG_TOUCHSCREEN_FTS_FT8720=m
CONFIG_SENSORS_A96T396=m
CONFIG_SENSORS_A96T396_LDO_SHARE=y
CONFIG_SENSORS_A96T396_CRC_CHECK=y
CONFIG_SENSORS_FW_VENDOR=y
CONFIG_SENSORS_A96T396_2CH=y
CONFIG_DC_VIBRATOR=m
CONFIG_SEC_PM_THERMISTOR=m
CONFIG_DIRECT_CHARGING=m
CONFIG_BATTERY_SAMSUNG=m
CONFIG_STEP_CHARGING=y
CONFIG_ENABLE_FULL_BY_SOC=y
CONFIG_SEC_PD=m
CONFIG_BATTERY_CISD=y
CONFIG_AFC_CHARGER_MODE=y
CONFIG_BATTERY_AGE_FORECAST=y
CONFIG_BATTERY_LOGGING=y
CONFIG_BATTERY_GKI=y
CONFIG_SUPPORT_HV_CTRL=y
CONFIG_BATTERY_SAMSUNG_REBOOT=y
CONFIG_MUIC_SM5714=m
CONFIG_MUIC_BCD_RESCAN=y
CONFIG_PDIC_SM5714=m
CONFIG_SM5714_FACTORY_MODE=y
CONFIG_EXT4_FS=y
CONFIG_EXT4_FS_POSIX_ACL=y
CONFIG_EXT4_FS_SECURITY=y
CONFIG_F2FS_FS=y
CONFIG_F2FS_FS_SECURITY=y
CONFIG_F2FS_FS_COMPRESSION=y
CONFIG_F2FS_UNFAIR_RWSEM=y
CONFIG_FS_ENCRYPTION=y
CONFIG_FS_ENCRYPTION_INLINE_CRYPT=y
CONFIG_FS_VERITY=y
CONFIG_FS_VERITY_BUILTIN_SIGNATURES=y
# CONFIG_DNOTIFY is not set
CONFIG_QUOTA=y
CONFIG_QFMT_V2=y
CONFIG_FUSE_FS=y
CONFIG_VIRTIO_FS=y
CONFIG_FUSE_BPF=y
CONFIG_OVERLAY_FS=y
CONFIG_INCREMENTAL_FS=y
CONFIG_MSDOS_FS=y
CONFIG_VFAT_FS=y
CONFIG_EXFAT_FS=y
CONFIG_NTFS_FS=y
CONFIG_NTFS_DEBUG=y
CONFIG_TMPFS=y
# CONFIG_EFIVAR_FS is not set
CONFIG_PSTORE=y
CONFIG_PSTORE_CONSOLE=y
CONFIG_PSTORE_PMSG=y
CONFIG_PSTORE_RAM=y
CONFIG_EROFS_FS=y
CONFIG_EROFS_FS_PCPU_KTHREAD=y
CONFIG_EROFS_FS_PCPU_KTHREAD_HIPRI=y
CONFIG_NLS_CODEPAGE_737=y
CONFIG_NLS_CODEPAGE_775=y
CONFIG_NLS_CODEPAGE_850=y
CONFIG_NLS_CODEPAGE_852=y
CONFIG_NLS_CODEPAGE_855=y
CONFIG_NLS_CODEPAGE_857=y
CONFIG_NLS_CODEPAGE_860=y
CONFIG_NLS_CODEPAGE_861=y
CONFIG_NLS_CODEPAGE_862=y
CONFIG_NLS_CODEPAGE_863=y
CONFIG_NLS_CODEPAGE_864=y
CONFIG_NLS_CODEPAGE_865=y
CONFIG_NLS_CODEPAGE_866=y
CONFIG_NLS_CODEPAGE_869=y
CONFIG_NLS_CODEPAGE_936=y
CONFIG_NLS_CODEPAGE_950=y
CONFIG_NLS_CODEPAGE_932=y
CONFIG_NLS_CODEPAGE_949=y
CONFIG_NLS_CODEPAGE_874=y
CONFIG_NLS_ISO8859_8=y
CONFIG_NLS_CODEPAGE_1250=y
CONFIG_NLS_CODEPAGE_1251=y
CONFIG_NLS_ASCII=y
CONFIG_NLS_ISO8859_2=y
CONFIG_NLS_ISO8859_3=y
CONFIG_NLS_ISO8859_4=y
CONFIG_NLS_ISO8859_5=y
CONFIG_NLS_ISO8859_6=y
CONFIG_NLS_ISO8859_7=y
CONFIG_NLS_ISO8859_9=y
CONFIG_NLS_ISO8859_13=y
CONFIG_NLS_ISO8859_14=y
CONFIG_NLS_ISO8859_15=y
CONFIG_NLS_KOI8_R=y
CONFIG_NLS_KOI8_U=y
CONFIG_NLS_MAC_ROMAN=y
CONFIG_NLS_MAC_CELTIC=y
CONFIG_NLS_MAC_CENTEURO=y
CONFIG_NLS_MAC_CROATIAN=y
CONFIG_NLS_MAC_CYRILLIC=y
CONFIG_NLS_MAC_GAELIC=y
CONFIG_NLS_MAC_GREEK=y
CONFIG_NLS_MAC_ICELAND=y
CONFIG_NLS_MAC_INUIT=y
CONFIG_NLS_MAC_ROMANIAN=y
CONFIG_NLS_MAC_TURKISH=y
CONFIG_UNICODE=y
CONFIG_SECURITY=y
CONFIG_SECURITYFS=y
CONFIG_SECURITY_NETWORK=y
CONFIG_HARDENED_USERCOPY=y
# CONFIG_HARDENED_USERCOPY_FALLBACK is not set
CONFIG_STATIC_USERMODEHELPER=y
CONFIG_STATIC_USERMODEHELPER_PATH=""
CONFIG_SECURITY_SELINUX=y
CONFIG_INTEGRITY_SIGNATURE=y
CONFIG_INTEGRITY_ASYMMETRIC_KEYS=y
CONFIG_KZT=y
CONFIG_INIT_ON_ALLOC_DEFAULT_ON=y
CONFIG_CRYPTO_CHACHA20POLY1305=y
CONFIG_CRYPTO_ADIANTUM=y
CONFIG_CRYPTO_XCBC=y
CONFIG_CRYPTO_BLAKE2B=y
CONFIG_CRYPTO_MD5=y
CONFIG_CRYPTO_DES=y
CONFIG_CRYPTO_TWOFISH=y
CONFIG_CRYPTO_LZO=y
CONFIG_CRYPTO_LZ4=y
CONFIG_CRYPTO_ZSTD=y
CONFIG_CRYPTO_ANSI_CPRNG=y
CONFIG_TRACE_MMIO_ACCESS=y
CONFIG_XZ_DEC=y
CONFIG_DMA_RESTRICTED_POOL=y
CONFIG_DMA_CMA=y
CONFIG_STACK_HASH_ORDER=12
CONFIG_PRINTK_TIME=y
CONFIG_PRINTK_CALLER=y
CONFIG_DYNAMIC_DEBUG_CORE=y
CONFIG_DEBUG_INFO=y
CONFIG_DEBUG_INFO_DWARF4=y
CONFIG_DEBUG_INFO_BTF=y
CONFIG_MODULE_ALLOW_BTF_MISMATCH=y
CONFIG_HEADERS_INSTALL=y
# CONFIG_SECTION_MISMATCH_WARN_ONLY is not set
CONFIG_MAGIC_SYSRQ=y
CONFIG_UBSAN=y
CONFIG_UBSAN_TRAP=y
CONFIG_UBSAN_LOCAL_BOUNDS=y
# CONFIG_UBSAN_SHIFT is not set
# CONFIG_UBSAN_BOOL is not set
# CONFIG_UBSAN_ENUM is not set
CONFIG_PAGE_OWNER=y
CONFIG_PAGE_PINNER=y
CONFIG_DEBUG_STACK_USAGE=y
CONFIG_DEBUG_MEMORY_INIT=y
CONFIG_KASAN=y
CONFIG_KASAN_HW_TAGS=y
CONFIG_KFENCE=y
CONFIG_KFENCE_SAMPLE_INTERVAL=500
CONFIG_KFENCE_NUM_OBJECTS=63
CONFIG_KFENCE_STATIC_KEYS=y
CONFIG_PANIC_ON_OOPS=y
CONFIG_PANIC_TIMEOUT=-1
CONFIG_SOFTLOCKUP_DETECTOR=y
CONFIG_WQ_WATCHDOG=y
CONFIG_SCHEDSTATS=y
CONFIG_BUG_ON_DATA_CORRUPTION=y
CONFIG_HIST_TRIGGERS=y
CONFIG_PID_IN_CONTEXTIDR=y
CONFIG_CORESIGHT=y
CONFIG_CORESIGHT_LINK_AND_SINK_TMC=y
CONFIG_CORESIGHT_CATU=y
CONFIG_CORESIGHT_SINK_TPIU=y
CONFIG_CORESIGHT_SINK_ETBV10=y
CONFIG_CORESIGHT_STM=y
CONFIG_FUNCTION_ERROR_INJECTION=y
# CONFIG_RUNTIME_TESTING_MENU is not set
```
